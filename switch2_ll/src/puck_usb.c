/*
 * The puck's USB identity: a Valve Steam Controller dongle.
 *
 * WHY BUILD THE USB DEVICE BY HAND. The board pulls in Zephyr's cdc_acm_serial
 * helper, which creates a USB device automatically so the console works with no
 * application code. Its own header rules it out for this: it is "intended for
 * use ... only in applications where no other USB features are required", it
 * hardcodes its VID/PID, and it "only registers the first CDC-ACM instance".
 * This puck needs a Valve identity and five interfaces, so
 * CONFIG_CDC_ACM_SERIAL_INITIALIZE_AT_BOOT is off and this file takes over. The
 * CDC console is registered here too, or the debug channel goes with it.
 *
 * WHY FOUR HID INTERFACES. A real dongle exposes one per bond slot and Steam
 * treats each as an independent controller, interface N owning slot N. It is
 * also the pairing path, so without these nothing can ever be bonded.
 */

#include <zephyr/kernel.h>
#include <zephyr/usb/usbd.h>
#include <zephyr/usb/usb_ch9.h>

#include "puck_usb.h"
#include "switch2_store.h"
#include "puck_webdisk.h"
#include "puck_hid.h"
#include "switch_pro_usb.h"
#include "puck_trace.h"

/*
 * 28DE:1304, Valve Software, Steam Controller. Steam identifies the dongle by
 * this, so it is not cosmetic: with any other VID/PID Steam will not talk to
 * the dongle at all.
 */
#define PUCK_VID 0x28DE
#define PUCK_PID 0x1304

USBD_DEVICE_DEFINE(puck_usbd, DEVICE_DT_GET(DT_NODELABEL(zephyr_udc0)),
		   PUCK_VID, PUCK_PID);

USBD_DESC_LANG_DEFINE(puck_lang);
USBD_DESC_MANUFACTURER_DEFINE(puck_mfr, "Valve Software");
USBD_DESC_PRODUCT_DEFINE(puck_product, "Steam Controller Puck");
USBD_DESC_MANUFACTURER_DEFINE(pro_mfr, "Nintendo Co., Ltd.");
USBD_DESC_PRODUCT_DEFINE(pro_product, "Pro Controller");
USBD_DESC_SERIAL_NUMBER_DEFINE(puck_sn);
USBD_DESC_CONFIG_DEFINE(puck_fs_cfg_desc, "FS Configuration");

/* Bus-powered: the puck is a dongle in a port, and a false self-powered claim
 * can affect how a host budgets current.
 */
USBD_CONFIGURATION_DEFINE(puck_fs_config, 0, 250, &puck_fs_cfg_desc);

/* Class instance names generated by Zephyr's HID class from the devicetree
 * instance index (USBD_DEFINE_CLASS(hid_##n, ...)), one per hid_slot_N node.
 */
static const char *const hid_class_name[PUCK_HID_SLOTS] = {
	"hid_0", "hid_1", "hid_2", "hid_3",
};

/*
 * The Pro Controller interface. Zephyr numbers HID class instances by their
 * devicetree order, and hid_pro is the fifth "zephyr,hid-device" node, so it
 * is hid_4. If that node is ever moved above the slots, this name moves with
 * it, which the boot log will say plainly rather than failing silently.
 */
#define PRO_CLASS_NAME "hid_4"

/* The mouse is the sixth "zephyr,hid-device" node, so hid_5. */
#define MOUSE_CLASS_NAME "hid_5"

/* Set at init; see puck_usb_is_pro() and puck_usb_has_dongle(). */
static bool g_is_pro;
static bool g_has_dongle;
static bool g_has_mouse;
static uint8_t g_mode_now;
static uint8_t g_prev_mode = 0xFF;

/*
 * Assemble whichever device this puck is meant to be.
 *
 * Two shapes, chosen from NVS before enumeration because USB is host-driven:
 * the device declares itself first, and nothing can be negotiated afterwards.
 *
 *   PRO     one Nintendo Pro Controller interface. The DEFAULT, and what a
 *           console binds. This is what the puck is for.
 *   DONGLE  four Valve HID interfaces. What Steam pairs a controller through,
 *           setup rather than everyday use, reached with the back-4 + L1 + R1
 *           chord on the controller, or the console 'm' key.
 *
 * A COMBINED SHAPE DOES NOT WORK, so there is no mode-free third option. One
 * device carrying both interface sets assembles cleanly as 28DE:1304 with
 * MI_00..MI_05 and Steam pairs through it, but Steam also claims the Pro
 * interface as a phantom gamepad and the input stutters. VID/PID is per-device,
 * not per-interface, so a composite can only claim one identity and the console
 * and Steam cannot share it.
 *
 * The CDC console is registered in both modes deliberately. On a puck with no
 * controller bonded it is the only way to change the mode at all.
 */
int puck_usb_init(void)
{
	uint8_t mode = switch2_store_take_usb_mode();

	g_mode_now = mode;
	puck_trace_stage(TR_USB_INIT);

	/*
	 * MOUSE_ONLY is a test, not a product mode. The console binds this
	 * device as a Pro Controller and may never look for a second interface
	 * on it, which would explain a mouse that enumerates, works perfectly
	 * on a PC, and produces no cursor on the console. Presenting ONLY a
	 * mouse settles that in one trip: a cursor means the console takes USB
	 * mice but not ones bundled with a pad.
	 */
	bool mouse_only = (mode == PUCK_USB_MODE_MOUSE);
	bool pro = (mode == PUCK_USB_MODE_PRO);
	bool want_pro = pro;
	bool want_dongle = (mode == PUCK_USB_MODE_DONGLE);
	bool want_mouse = pro || mouse_only;
	int err;

	g_is_pro = want_pro;
	g_has_dongle = want_dongle;
	g_has_mouse = want_mouse;

	/* Read what the PREVIOUS boot came up as before recording this one.
	 * That is the console trip, and it is a power cycle away from being
	 * readable.
	 */
	if (!switch2_store_load_last_mode(&g_prev_mode)) {
		g_prev_mode = 0xFF;	/* no record */
	}
	switch2_store_save_last_mode(mode);

	/* Independent of mode: the config surface reports it in every mode. */
	switch_pro_usb_load_cal();

	err = usbd_add_descriptor(&puck_usbd, &puck_lang);
	if (err) {
		printk("usb: lang descriptor failed (%d)\n", err);
		return err;
	}
	err = usbd_add_descriptor(&puck_usbd, pro ? &pro_mfr : &puck_mfr);
	if (err) {
		printk("usb: manufacturer descriptor failed (%d)\n", err);
		return err;
	}
	err = usbd_add_descriptor(&puck_usbd, pro ? &pro_product : &puck_product);
	if (err) {
		printk("usb: product descriptor failed (%d)\n", err);
		return err;
	}
	/* Serial number comes from HWINFO. Zephyr's own helper guards this with
	 * IF_ENABLED(CONFIG_HWINFO) because the descriptor is unusable without
	 * it, and a malformed device descriptor is exactly the kind of fault
	 * that shows up as a failed port reset rather than an error message.
	 */
	if (IS_ENABLED(CONFIG_HWINFO)) {
		err = usbd_add_descriptor(&puck_usbd, &puck_sn);
		if (err) {
			printk("usb: serial descriptor failed (%d)\n", err);
		}
	}

	/* PRO overrides the compile-time Valve identity. */
	if (pro) {
		usbd_device_set_vid(&puck_usbd, SWPRO_VID);
		usbd_device_set_pid(&puck_usbd, SWPRO_PID);
		usbd_device_set_bcd_device(&puck_usbd, 0x0220);
	}

	/*
	 * Report descriptors BEFORE the device is assembled. Zephyr's HID class
	 * contributes no interface descriptor until hid_device_register() has
	 * run, and usbd_init() then rejects the whole device with -EINVAL.
	 */
	if (want_dongle) {
		puck_hid_register_all();
	} else {
		/* The bonds are what RF beacons for, so they must be loaded
		 * even when the dongle interfaces are not registered.
		 */
		puck_hid_restore_bonds();
	}
	if (want_pro) {
		switch_pro_usb_register();
	}
	if (want_mouse) {
		switch_pro_mouse_register();
	}

	err = usbd_add_configuration(&puck_usbd, USBD_SPEED_FS, &puck_fs_config);
	if (err) {
		printk("usb: add configuration failed (%d)\n", err);
		return err;
	}

	/*
	 * DONGLE INTERFACES FIRST. Steam maps slot N to the Nth HID interface,
	 * so their position must not shift, which is why the Pro Controller
	 * interface is registered after them, never before.
	 *
	 * A failure here is logged and stepped over rather than returned.
	 * Bailing out skips usbd_init() and usbd_enable() entirely, so one bad
	 * HID registration takes the CDC console with it and the board
	 * enumerates as "Unknown USB Device (Port Reset Failed)": no way to see
	 * what went wrong, and no way to reflash without a double-tap.
	 */
	if (want_dongle) {
		for (int i = 0; i < PUCK_HID_SLOTS; i++) {
			err = usbd_register_class(&puck_usbd, hid_class_name[i],
						  USBD_SPEED_FS, 1);
			if (err) {
				printk("usb: registering %s FAILED (%d): "
				       "continuing so the console still comes "
				       "up\n",
				       hid_class_name[i], err);
			}
		}
	}
	if (want_pro) {
		err = usbd_register_class(&puck_usbd, PRO_CLASS_NAME,
					  USBD_SPEED_FS, 1);
		if (err) {
			printk("usb: registering %s FAILED (%d): no pad will "
			       "appear\n", PRO_CLASS_NAME, err);
		}
	}
	if (want_mouse) {
		err = usbd_register_class(&puck_usbd, MOUSE_CLASS_NAME,
					  USBD_SPEED_FS, 1);
		if (err) {
			printk("usb: registering %s FAILED (%d): no mouse\n",
			       MOUSE_CLASS_NAME, err);
		}
	}

	/*
	 * The config drive, in dongle mode only.
	 *
	 * Registered after the Steam interfaces so it cannot shift their
	 * numbering. Steam maps slot N to the Nth HID interface. Adding a
	 * class to the Valve identity is what COMBO got wrong, but what broke
	 * there was a second HID GAMEPAD, which Steam claimed as a phantom
	 * controller; mass storage gives it nothing to claim, and the CDC
	 * console has ridden alongside these interfaces all along.
	 */
	if (want_dongle && !puck_webdisk_init()) {
		err = usbd_register_class(&puck_usbd, "msc_0", USBD_SPEED_FS, 1);
		if (err) {
			printk("usb: registering the config drive FAILED (%d)"
			       ": everything else still comes up\n", err);
		}
	}

	/* The CDC console. Registered last so it cannot shift the HID interface
	 * numbering, and registered at all only because the auto-init helper is
	 * disabled. Without this there is no serial console.
	 */
	err = usbd_register_class(&puck_usbd, "cdc_acm_0", USBD_SPEED_FS, 1);
	if (err) {
		printk("usb: registering the CDC console FAILED (%d)\n", err);
	}

	err = usbd_init(&puck_usbd);
	if (err) {
		printk("usb: usbd_init failed (%d)\n", err);
		return err;
	}

	err = usbd_enable(&puck_usbd);
	if (err) {
		printk("usb: usbd_enable failed (%d)\n", err);
		return err;
	}

	if (mouse_only) {
		printk("usb: %04X:%04X up: MOUSE ONLY + console\n",
		       PUCK_VID, PUCK_PID);
		printk("     (testing whether the console takes a USB mouse "
		       "that is not bundled with a pad)\n");
	} else if (pro) {
		printk("usb: %04X:%04X up: PRO CONTROLLER + mouse + console\n",
		       SWPRO_VID, SWPRO_PID);
		printk("     (back-4 + L1 + R1 switches to Steam/dongle mode)\n");
	} else {
		printk("usb: %04X:%04X up, %d HID interfaces + console\n",
		       PUCK_VID, PUCK_PID, PUCK_HID_SLOTS);
	}
	return 0;
}

/*
 * Which interfaces THIS boot actually brought up.
 *
 * Ask these rather than re-reading NVS: they report what THIS boot actually
 * registered, which is what callers care about. is_pro() drives "force RF" (a
 * pad needs input to send); has_dongle() gates the Steam-facing connection
 * reports, which must never run when there is no interface to send them on.
 * That was a NULL dereference that took the whole firmware down on the first
 * RF poll.
 */
bool puck_usb_is_pro(void)
{
	return g_is_pro;
}

bool puck_usb_has_dongle(void)
{
	return g_has_dongle;
}

/*
 * Does this boot need the radio on RF?
 *
 * Anything that sends the controller's input onward does: the Pro Controller
 * for buttons and sticks, and mouse-only mode for the trackpad. Only the dongle
 * can sit on BLE, because Steam pairs over USB and RF starts afterwards.
 */
bool puck_usb_needs_rf(void)
{
	return g_is_pro || g_has_mouse;
}

static const char *mode_name(uint8_t m)
{
	switch (m) {
	case PUCK_USB_MODE_DONGLE: return "VALVE DONGLE";
	case PUCK_USB_MODE_PRO:    return "PRO CONTROLLER + mouse";
	case PUCK_USB_MODE_MOUSE:  return "MOUSE ONLY";
	default:                   return "(no record)";
	}
}

/*
 * What this boot came up as, and what the one before it did.
 *
 * The second half is the point: a console trip is always a power cycle away
 * from being readable, and a mouse-only test that quietly ran as a Pro
 * Controller is indistinguishable from a mouse the console ignored.
 */
void puck_usb_dump_mode(void)
{
	printk("usb mode: this boot %s  |  previous boot %s\n",
	       mode_name(g_mode_now), mode_name(g_prev_mode));
}
